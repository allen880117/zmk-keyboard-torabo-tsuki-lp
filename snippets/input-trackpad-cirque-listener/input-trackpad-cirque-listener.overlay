/*
 * Listener processors for the trackpad, on the half that has it. Use with
 * input-trackpad-cirque and input-listener.
 *
 * Replaces the shield's trackball processors: orientation is set in the
 * driver (x-invert / y-invert), and there is no cursor inertia, since
 * lifting a finger off a pad should stop the cursor. The scroll layer is
 * the same as the trackball's: hold layer 3 and slide to scroll.
 */

#include <dt-bindings/zmk/input_transform.h>

&pointing_listener {
    input-processors = <&tp_accel>;

    scroller {
        input-processors = <&scroll_accel>,
                           <&zip_xy_to_scroll_mapper>,
                           <&zip_scroll_scaler 1 6>,
                           <&zip_scroll_transform INPUT_TRANSFORM_Y_INVERT>,
                           <&zip_inertia>;
    };
};

/ {
    /* The trackpad's own acceleration curve, so the trackball's
     * &vector_accel stays as it is. Speeds are in pad counts per second
     * (about 45 counts per mm; one full swipe across the pad is ~1800).
     * This curve is the whole speed setting: about 1.8x KYENS's gain on
     * slow moves, and about 2.4x on fast ones. */
    tp_accel: tp_accel {
        compatible = "zmk,input-processor-vector-acceleration";
        status = "okay";
        #input-processor-cells = <0>;
        track-remainders;

        min-factor = <400>;   /* 0.4x on slow, careful moves (~5 mm/s) */
        unity-speed = <1500>; /* 1.0x at a normal move (~35 mm/s) */
        max-factor = <2500>;  /* 2.5x on a fast swipe */
        max-speed = <8000>;   /* full boost from ~180 mm/s */
    };
};
